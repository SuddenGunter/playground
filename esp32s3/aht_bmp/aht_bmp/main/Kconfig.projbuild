## esp32s3/aht_bmp/aht_bmp/main/Kconfig.projbuild
```kconfig
menu "I2C"
    config I2C_MASTER_SCL
        int "I2C SCL pin"
        range 0 48
        default 9
    config I2C_MASTER_SDA
        int "I2C SDA pin"
        range 0 48
        default 8
endmenu
```
