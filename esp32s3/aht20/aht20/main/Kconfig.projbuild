## esp32s3/aht20/aht20/main/Kconfig.projbuild
```kconfig
menu "AHT20 I2C"
    config I2C_MASTER_SCL
        int "I2C SCL pin"
        range 0 48
        default 4
    config I2C_MASTER_SDA
        int "I2C SDA pin"
        range 0 48
        default 5
endmenu
```
